## arch/rh850/Kconfig
```kconfig
#
# For a description of the syntax of this configuration file,
# see the file kconfig-language.txt in the NuttX tools repository.
#

if ARCH_RH850
comment "RH850 Options"

choice
	prompt "rh850 Toolchain Selection"
	default RH850_TOOLCHAIN_GHS

config RH850_TOOLCHAIN_GHS
	bool "rh850 ghs tool chain"
	select ARCH_TOOLCHAIN_GHS

endchoice # rh850 Toolchain Selection

config ARCH_RH850G3K
	bool
	default n

config ARCH_U2AX
	bool
	select ARCH_HAVE_TESTSET
	default n

config ARCH_FAMILY
	string
	default "u2ax"		if ARCH_U2AX

config ARCH_CHIP
	string
	default "u2ax"		if ARCH_CHIP_U2A16ICUM

config ARCH_CHIP_U2A16ICUM
	bool "RH850 Family U2A16ICUM"
	select ARCH_U2AX
	select ARCH_RH850G3K
	select ALARM_ARCH
	select ARCH_IRQPRIO
	select ARCH_HAVE_IRQPRIO
	select ARCH_HAVE_IRQTRIGGER
	select ONESHOT
	---help---
		RH850 U2AX family: U2A16ICUM

source "arch/rh850/src/common/Kconfig"

if ARCH_U2AX
source "arch/rh850/src/u2ax/Kconfig"
endif

if ARCH_RH850G3K
source "arch/rh850/src/rh850g3k/Kconfig"
endif

endif # ARCH_RH850
```

## arch/tricore/Kconfig
```kconfig
#
# For a description of the syntax of this configuration file,
# see the file kconfig-language.txt in the NuttX tools repository.
#

if ARCH_TRICORE
comment "Tricore Options"

choice
	prompt "Tricore Toolchain Selection"
	default TRICORE_TOOLCHAIN_GNU

config TRICORE_TOOLCHAIN_TASKING
	bool "AURIX Tasking C/C++ toolchain"
	select ARCH_TOOLCHAIN_TASKING

config TRICORE_TOOLCHAIN_GNU
	bool "Generic GNU toolchain"
	select ARCH_TOOLCHAIN_GNU
	---help---
		This option should work for any modern GNU toolchain (GCC 4.5 or newer)

endchoice # Tricore Toolchain Selection

config ARCH_TC3XX
	bool
	select ARCH_HAVE_TESTSET
	default n

config ARCH_TC4XX
	bool
	select ARCH_HAVE_TESTSET
	default n

config ARCH_FAMILY
	string
	default "tc3xx"		if ARCH_TC3XX
	default "tc4xx"		if ARCH_TC4XX

config ARCH_CHIP
	string
	default "tc3xx"		if ARCH_CHIP_TC397
	default "tc4xx"		if ARCH_CHIP_TC499

config ARCH_CHIP_TC397
	bool "AURIX Family TC397"
	select ARCH_TC3XX
	select ARCH_HAVE_IRQTRIGGER
	select ALARM_ARCH
	select ONESHOT
	---help---
		AURIX TC39x family: TC397

config ARCH_CHIP_TC499
	bool "AURIX Family TC499"
	select ARCH_TC4XX
	select ALARM_ARCH
	select ONESHOT
	---help---
		AURIX TC49x family: TC499

config ARCH_CHIP_TRICORE_CUSTOM
	bool "Custom Tricore chip"
	select ARCH_CHIP_CUSTOM
	---help---
		Select this option if there is no directory for the chip under arch/tricore/src/.

source "arch/tricore/src/common/Kconfig"

if ARCH_TC3XX
source "arch/tricore/src/tc3xx/Kconfig"
endif

if ARCH_TC4XX
source "arch/tricore/src/tc4xx/Kconfig"
endif
endif # ARCH_TRICORE
```

## arch/tricore/src/common/Kconfig
```kconfig
#
# For a description of the syntax of this configuration file,
# see the file kconfig-language.txt in the NuttX tools repository.
#

comment "TRICORE Configuration Options"

menu "TRICORE Peripheral Support"

# These are the peripheral selections proper

config TRICORE_UART0
	bool "TRICORE UART0"
	default y
	select UART0_SERIALDRIVER
	select ARCH_HAVE_SERIAL_TERMIOS

endmenu
```

## sched/knsh/Kconfig
```kconfig
#
# For a description of the syntax of this configuration file,
# see the file kconfig-language.txt in the NuttX tools repository.
#

menu "Kernel NuttShell"

config KNSH
	bool "Kernel NuttShell Support"
	default n
	---help---
		Enable Kernel NuttShell.If enabled, the Kernel NuttShell is
		accessed when os panic occurs

if KNSH

menu "Command Line Configuration"

config KNSH_PROMPT_STRING
	string "KNSH Prompt String"
	default "knsh> "
	---help---
		Provide the shell prompt string with size limit KNSH_PROMPT_MAX.
		default is "knsh> ".

config KNSH_PROMPT_SUFFIX
	string "Suffix used to derive fallback prompt string"
	default "> "
	---help---
		When KNSH_PROMPT_STRING is empty, the cpu id or hostname will
		be used to derive the prompt at runtime. This suffix is a part
		of the final prompt that serves to clearly separate prompt from
		user inputs.

config KNSH_PROMPT_MAX
	int "Maximum Size of Prompt String"
	default NAME_MAX
	---help---
		The maximum size of shell prompt string, including ending null.

config KNSH_LINELEN
	int "Max command line length"
	default 64 if DEFAULT_SMALL
	default 80 if !DEFAULT_SMALL
	---help---
		The maximum length of one command line and of one output line.
		Default: 64/80

config KNSH_MAXARGUMENTS
	int "Maximum number of command arguments"
	default 7
	---help---
		The maximum number of KNSH command arguments.
		Default: 7

endmenu # Command Line Configuration

menu "Disable Individual commands"

config KNSH_DISABLE_HELP
	bool "Disable help"
	default n

config KNSH_DISABLE_MB
	bool "Disable mb"
	default y

config KNSH_DISABLE_MH
	bool "Disable mh"
	default y

config KNSH_DISABLE_MW
	bool "Disable mw"
	default y

config KNSH_DISABLE_XD
	bool "Disable xd"
	default DEFAULT_SMALL

config KNSH_DISABLE_EXIT
	bool "Disable exit"
	default DEFAULT_SMALL

endmenu

config KNSH_SC
	bool "Enable KNSH command of switch core in BMP"
	depends on BMP
	default y

if KNSH_SC

config KNSH_UART_IRQ
	int "Uart IRQ number for switch core of shell"
	default 0
	---help---
		Uart IRQ number for switch core of shell

endif

endif
endmenu
```
